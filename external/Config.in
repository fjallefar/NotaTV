## external/Config.in
```kconfig
menu "NotaTV"
source "$BR2_EXTERNAL_NOTATV_PATH/package/tvshell/Config.in"
source "$BR2_EXTERNAL_NOTATV_PATH/package/yt-dlp/Config.in"
source "$BR2_EXTERNAL_NOTATV_PATH/package/uxplay/Config.in"
source "$BR2_EXTERNAL_NOTATV_PATH/package/rpi-tools/Config.in"
source "$BR2_EXTERNAL_NOTATV_PATH/package/libgamestream/Config.in"
source "$BR2_EXTERNAL_NOTATV_PATH/package/tvmoon/Config.in"
endmenu
```

## external/configs/notatv_x86_64_defconfig
```kconfig
# --- Architecture and toolchain ---
BR2_x86_64=y
BR2_x86_x86_64_v3=y
BR2_TOOLCHAIN_EXTERNAL=y
BR2_TOOLCHAIN_EXTERNAL_BOOTLIN=y
BR2_TOOLCHAIN_EXTERNAL_BOOTLIN_X86_64_V3_GLIBC_STABLE=y
BR2_DL_DIR="$(BR2_EXTERNAL_NOTATV_PATH)/../dl"
BR2_CCACHE=y
BR2_CCACHE_DIR="$(BR2_EXTERNAL_NOTATV_PATH)/../.ccache"
BR2_OPTIMIZE_2=y

# --- System ---
BR2_TARGET_GENERIC_HOSTNAME="notatv"
BR2_TARGET_GENERIC_ISSUE="NotaTV"
BR2_TARGET_GENERIC_ROOT_PASSWD="notatv"
BR2_INIT_BUSYBOX=y
BR2_ROOTFS_DEVICE_CREATION_DYNAMIC_DEVTMPFS=y
BR2_TARGET_GENERIC_GETTY_PORT="ttyS0"
BR2_TARGET_GENERIC_GETTY_BAUDRATE_115200=y
BR2_SYSTEM_DHCP=""
BR2_TARGET_TZ_INFO=y
BR2_TARGET_LOCALTIME="Europe/Copenhagen"
BR2_ROOTFS_OVERLAY="$(BR2_EXTERNAL_NOTATV_PATH)/board/notatv/rootfs-overlay"
BR2_ROOTFS_POST_BUILD_SCRIPT="$(BR2_EXTERNAL_NOTATV_PATH)/board/notatv/post-build.sh"
BR2_ROOTFS_POST_IMAGE_SCRIPT="$(BR2_EXTERNAL_NOTATV_PATH)/board/notatv/post-image.sh"
BR2_PACKAGE_BUSYBOX_CONFIG_FRAGMENT_FILES="$(BR2_EXTERNAL_NOTATV_PATH)/board/notatv/busybox.fragment"

# --- Kernel ---
BR2_LINUX_KERNEL=y
BR2_LINUX_KERNEL_LATEST_VERSION=y
BR2_LINUX_KERNEL_USE_ARCH_DEFAULT_CONFIG=y
BR2_LINUX_KERNEL_CONFIG_FRAGMENT_FILES="$(BR2_EXTERNAL_NOTATV_PATH)/board/notatv/linux.fragment"
BR2_LINUX_KERNEL_BZIMAGE=y
BR2_LINUX_KERNEL_NEEDS_HOST_LIBELF=y
BR2_LINUX_KERNEL_NEEDS_HOST_OPENSSL=y

# --- Firmware ---
BR2_PACKAGE_LINUX_FIRMWARE=y
BR2_PACKAGE_LINUX_FIRMWARE_I915=y
BR2_PACKAGE_LINUX_FIRMWARE_IWLWIFI_7265D=y
BR2_PACKAGE_LINUX_FIRMWARE_IWLWIFI_8000C=y
BR2_PACKAGE_LINUX_FIRMWARE_IWLWIFI_8265=y
BR2_PACKAGE_LINUX_FIRMWARE_IWLWIFI_9XXX=y
BR2_PACKAGE_LINUX_FIRMWARE_IWLWIFI_22000=y
BR2_PACKAGE_LINUX_FIRMWARE_IWLWIFI_QUZ=y
BR2_PACKAGE_LINUX_FIRMWARE_RTL_8169=y
BR2_PACKAGE_LINUX_FIRMWARE_RTL_RTW88=y
BR2_PACKAGE_LINUX_FIRMWARE_RTL_RTW89=y

# --- Graphics and video ---
BR2_PACKAGE_MESA3D=y
BR2_PACKAGE_MESA3D_GALLIUM_DRIVER_IRIS=y
BR2_PACKAGE_MESA3D_GALLIUM_DRIVER_SOFTPIPE=y
BR2_PACKAGE_MESA3D_GBM=y
BR2_PACKAGE_MESA3D_OPENGL_EGL=y
BR2_PACKAGE_MESA3D_OPENGL_ES=y
BR2_PACKAGE_LIBDRM_INTEL=y
BR2_PACKAGE_LIBVA=y
BR2_PACKAGE_INTEL_MEDIADRIVER=y
BR2_PACKAGE_LIBVA_UTILS=y
BR2_PACKAGE_FFMPEG=y
BR2_PACKAGE_FFMPEG_GPL=y
BR2_PACKAGE_FFMPEG_FFPROBE=y
BR2_PACKAGE_FFMPEG_SWSCALE=y
BR2_PACKAGE_LUAJIT=y
BR2_PACKAGE_MPV=y
BR2_PACKAGE_SDL3=y
BR2_PACKAGE_SDL3_OPENGLES=y
BR2_PACKAGE_SDL3_KMSDRM=y

# --- Audio ---
BR2_PACKAGE_ALSA_LIB=y
BR2_PACKAGE_ALSA_UTILS=y
BR2_PACKAGE_ALSA_UTILS_AMIXER=y
BR2_PACKAGE_ALSA_UTILS_APLAY=y
BR2_PACKAGE_ALSA_UTILS_SPEAKER_TEST=y

# --- Network ---
BR2_PACKAGE_CA_CERTIFICATES=y
BR2_PACKAGE_OPENSSL=y
BR2_PACKAGE_LIBCURL=y
BR2_PACKAGE_LIBCURL_OPENSSL=y
BR2_PACKAGE_LIBCURL_CURL=y
BR2_PACKAGE_GNUTLS=y
BR2_PACKAGE_WPA_SUPPLICANT=y
BR2_PACKAGE_WPA_SUPPLICANT_CLI=y
BR2_PACKAGE_DROPBEAR=y

# --- HDMI-CEC ---
BR2_PACKAGE_LIBV4L=y
BR2_PACKAGE_LIBV4L_UTILS=y
BR2_PACKAGE_LINUXCONSOLETOOLS=y
BR2_PACKAGE_LINUXCONSOLETOOLS_INPUTATTACH=y

# --- Installing to disk ---
BR2_PACKAGE_UTIL_LINUX=y
BR2_PACKAGE_UTIL_LINUX_BINARIES=y
BR2_PACKAGE_UTIL_LINUX_WIPEFS=y
BR2_PACKAGE_E2FSPROGS=y
BR2_PACKAGE_DOSFSTOOLS=y
BR2_PACKAGE_DOSFSTOOLS_MKFS_FAT=y
BR2_PACKAGE_EFIBOOTMGR=y

# --- Diverse ---
BR2_PACKAGE_HTOP=y
BR2_PACKAGE_DEJAVU=y

# --- NotaTV ---
BR2_PACKAGE_TVSHELL=y
BR2_PACKAGE_YT_DLP=y

# --- Image: rootfs embedded in the kernel (runs from RAM) ---
BR2_TARGET_ROOTFS_CPIO=y
BR2_TARGET_ROOTFS_CPIO_NONE=y
BR2_TARGET_ROOTFS_INITRAMFS=y
# BR2_TARGET_ROOTFS_TAR is not set
BR2_PACKAGE_HOST_DOSFSTOOLS=y
BR2_PACKAGE_HOST_MTOOLS=y
BR2_PACKAGE_HOST_XORRISO=y
BR2_GLOBAL_PATCH_DIR="$(BR2_EXTERNAL_NOTATV_PATH)/board/notatv/patches"
# Casting (phase 1): AirPlay audio - all open source (shairport-sync MIT/BSD, nqptp GPL, avahi LGPL, dbus GPL/AFL)
BR2_PACKAGE_DBUS=y
BR2_PACKAGE_AVAHI=y
BR2_PACKAGE_AVAHI_DAEMON=y
# BR2_PACKAGE_AVAHI_AUTOIPD is not set
BR2_PACKAGE_AVAHI_LIBAVAHI_CLIENT=y
BR2_PACKAGE_SHAIRPORT_SYNC=y
BR2_PACKAGE_SHAIRPORT_SYNC_AIRPLAY2=y
# Casting (phase 2): Bluetooth audio - BlueZ (GPL) + bluez-alsa (MIT)
BR2_PACKAGE_BLUEZ5_UTILS=y
BR2_PACKAGE_BLUEZ5_UTILS_CLIENT=y
BR2_PACKAGE_BLUEZ5_UTILS_PLUGINS_AUDIO=y
BR2_PACKAGE_BLUEZ_ALSA=y
# Casting (phase 3): DLNA receiver (libupnp/pupnp, BSD)
BR2_PACKAGE_LIBUPNP=y
# Casting (phase 4): WebSocket for Jellyfin remote control
BR2_PACKAGE_LIBCURL_WEBSOCKETS_SUPPORT=y
BR2_PACKAGE_UXPLAY=y
```

## external/package/libgamestream/Config.in
```kconfig
config BR2_PACKAGE_LIBGAMESTREAM
	bool "libgamestream"
	select BR2_PACKAGE_OPENSSL
	select BR2_PACKAGE_LIBCURL
	select BR2_PACKAGE_EXPAT
	select BR2_PACKAGE_UTIL_LINUX
	select BR2_PACKAGE_UTIL_LINUX_LIBUUID
	help
	  Moonlight-protokollen (moonlight-common-c) og parring/app-liste
	  (libgamestream fra moonlight-embedded) som ét statisk bibliotek
	  til tvmoon. Open source, GPL-3.

	  https://github.com/moonlight-stream/moonlight-embedded
	  https://github.com/moonlight-stream/moonlight-common-c
```

## external/package/rpi-tools/Config.in
```kconfig
config BR2_PACKAGE_RPI_TOOLS
	bool "rpi-tools"
	depends on BR2_aarch64
	help
	  NotaTV-værktøjer til Raspberry Pi 4: tvmon (temperatur, clocks,
	  spænding og throttling fra firmwaren) og tryboot (genstart én gang
	  med tryboot.txt - bruges til sikker overclocking).
```

## external/package/tvmoon/Config.in
```kconfig
config BR2_PACKAGE_TVMOON
	bool "tvmoon"
	select BR2_PACKAGE_LIBGAMESTREAM
	select BR2_PACKAGE_FFMPEG
	select BR2_PACKAGE_LIBDRM
	select BR2_PACKAGE_ALSA_LIB
	select BR2_PACKAGE_OPUS
	select BR2_PACKAGE_AVAHI
	select BR2_PACKAGE_AVAHI_LIBAVAHI_CLIENT
	help
	  NotaTV' spilstreaming-klient (Moonlight-protokollen mod
	  Sunshine). Video dekodes i hardware direkte til skærmplanet.
```

## external/package/tvshell/Config.in
```kconfig
config BR2_PACKAGE_TVSHELL
	bool "tvshell"
	depends on BR2_PACKAGE_SDL3_KMSDRM
	select BR2_PACKAGE_LIBCURL
	help
	  NotaTV brugerflade (launcher, IPTV, Plex, Spotify, indstillinger).
```

## external/package/uxplay/Config.in
```kconfig
config BR2_PACKAGE_UXPLAY
	bool "uxplay"
	depends on BR2_INSTALL_LIBSTDCPP
	select BR2_PACKAGE_OPENSSL
	select BR2_PACKAGE_LIBPLIST
	select BR2_PACKAGE_AVAHI
	select BR2_PACKAGE_AVAHI_DAEMON
	select BR2_PACKAGE_AVAHI_LIBDNSSD_COMPATIBILITY
	select BR2_PACKAGE_GSTREAMER1
	select BR2_PACKAGE_GST1_PLUGINS_BASE
	select BR2_PACKAGE_GST1_PLUGINS_BASE_PLUGIN_APP
	select BR2_PACKAGE_GST1_PLUGINS_BASE_PLUGIN_AUDIOCONVERT
	select BR2_PACKAGE_GST1_PLUGINS_BASE_PLUGIN_AUDIORESAMPLE
	select BR2_PACKAGE_GST1_PLUGINS_BASE_PLUGIN_PLAYBACK
	select BR2_PACKAGE_GST1_PLUGINS_BASE_PLUGIN_TCP
	select BR2_PACKAGE_GST1_PLUGINS_BASE_PLUGIN_TYPEFIND
	select BR2_PACKAGE_GST1_PLUGINS_BASE_PLUGIN_VOLUME
	select BR2_PACKAGE_GST1_PLUGINS_BASE_PLUGIN_ALSA
	select BR2_PACKAGE_GST1_PLUGINS_BASE_PLUGIN_VIDEOCONVERTSCALE
	select BR2_PACKAGE_GST1_PLUGINS_GOOD
	select BR2_PACKAGE_GST1_PLUGINS_GOOD_PLUGIN_AUTODETECT
	select BR2_PACKAGE_GST1_PLUGINS_GOOD_PLUGIN_LEVEL
	select BR2_PACKAGE_GST1_PLUGINS_GOOD_PLUGIN_RTP
	select BR2_PACKAGE_GST1_PLUGINS_BAD
	select BR2_PACKAGE_GST1_PLUGINS_BAD_PLUGIN_VIDEOPARSERS
	select BR2_PACKAGE_GST1_LIBAV
	help
	  AirPlay-skærmspejling og -lyd (open source, GPL-3).
	  NotaTV bruger den til spejling fra iPhone/iPad/Mac; videoen
	  sendes videre til mpv (src/shell/mirror.c).

	  https://github.com/FDH2/UxPlay
```

## external/package/yt-dlp/Config.in
```kconfig
config BR2_PACKAGE_YT_DLP
	bool "yt-dlp"
	depends on BR2_aarch64
	select BR2_PACKAGE_QUICKJS
	help
	  yt-dlp (selvstændig aarch64-binær) til YouTube-afspilning.
	  QuickJS bruges som JavaScript-motor til YouTubes signaturer.
```
