## external/Config.in
```kconfig
menu "NotaTV"
source "$BR2_EXTERNAL_NOTATV_PATH/package/tvshell/Config.in"
source "$BR2_EXTERNAL_NOTATV_PATH/package/yt-dlp/Config.in"
source "$BR2_EXTERNAL_NOTATV_PATH/package/uxplay/Config.in"
source "$BR2_EXTERNAL_NOTATV_PATH/package/rpi-tools/Config.in"
source "$BR2_EXTERNAL_NOTATV_PATH/package/libgamestream/Config.in"
source "$BR2_EXTERNAL_NOTATV_PATH/package/tvmoon/Config.in"
source "$BR2_EXTERNAL_NOTATV_PATH/package/retroarch/Config.in"
source "$BR2_EXTERNAL_NOTATV_PATH/package/libretro-fceumm/Config.in"
source "$BR2_EXTERNAL_NOTATV_PATH/package/libretro-mgba/Config.in"
source "$BR2_EXTERNAL_NOTATV_PATH/package/libretro-pcsx-rearmed/Config.in"
source "$BR2_EXTERNAL_NOTATV_PATH/package/retroarch-joypad-autoconfig/Config.in"
endmenu
```

## external/package/libretro-fceumm/Config.in
```kconfig
config BR2_PACKAGE_LIBRETRO_FCEUMM
	bool "libretro-fceumm"
	help
	  FCEUmm (GPL-2.0) libretro core: NES / Famicom. For the app "retro".
```

## external/package/libretro-mgba/Config.in
```kconfig
config BR2_PACKAGE_LIBRETRO_MGBA
	bool "libretro-mgba"
	help
	  mGBA (MPL-2.0) libretro core: Game Boy, Game Boy Color, Game Boy
	  Advance. For the app "retro".
```

## external/package/libretro-pcsx-rearmed/Config.in
```kconfig
config BR2_PACKAGE_LIBRETRO_PCSX_REARMED
	bool "libretro-pcsx-rearmed"
	help
	  PCSX ReARMed (GPL-2.0) libretro core: PlayStation 1, with the
	  ARM64 dynarec. For the app "retro".
```

## external/package/retroarch-joypad-autoconfig/Config.in
```kconfig
config BR2_PACKAGE_RETROARCH_JOYPAD_AUTOCONFIG
	bool "retroarch-joypad-autoconfig"
	help
	  RetroArch's controller profiles (MIT) for udev, so controllers
	  work in the app "retro" without setup. Staging only.
```

## external/package/retroarch/Config.in
```kconfig
config BR2_PACKAGE_RETROARCH
	bool "retroarch"
	depends on BR2_PACKAGE_HAS_LIBEGL && BR2_PACKAGE_HAS_LIBGLES
	select BR2_PACKAGE_ALSA_LIB
	select BR2_PACKAGE_LIBDRM
	select BR2_PACKAGE_ZLIB
	help
	  RetroArch (GPL-3.0) for the NotaTV app "retro": runs libretro
	  cores full screen on KMS/DRM with GLES. Installed into staging
	  only - the app package carries it, the image does not.
```
